## src/mainboard/clevo/n650du/Kconfig
```kconfig
## SPDX-License-Identifier: GPL-2.0-only

if BOARD_CLEVO_N650DU

config BOARD_SPECIFIC_OPTIONS
	def_bool y
	select BOARD_ROMSIZE_KB_8192
	select EC_ACPI
	select HAVE_ACPI_RESUME
	select HAVE_ACPI_TABLES
	select HAVE_CMOS_DEFAULT
	select HAVE_OPTION_TABLE
	select INTEL_GMA_ADD_VBT
	select INTEL_GMA_HAVE_VBT
	select INTEL_LPSS_UART_FOR_CONSOLE
	select MAINBOARD_HAS_LIBGFXINIT
	select MAINBOARD_HAS_TPM2
	select MAINBOARD_SUPPORTS_KABYLAKE_CPU
	select MAINBOARD_SUPPORTS_SKYLAKE_CPU
	select MEMORY_MAPPED_TPM
	select NO_UART_ON_SUPERIO
	select SKYLAKE_SOC_PCH_H
	select SOC_INTEL_COMMON_BLOCK_HDA_VERB
	select SOC_INTEL_KABYLAKE
	select SPD_READ_BY_WORD
	select SYSTEM_TYPE_LAPTOP

config MAINBOARD_DIR
	default "clevo/n650du"

config MAINBOARD_PART_NUMBER
	default "N650DU"

config INTEL_GMA_VBT_FILE
	default "src/mainboard/\$(MAINBOARDDIR)/data.vbt"

config DIMM_SPD_SIZE
	default 512	# DDR4

config DIMM_MAX
	default 2

config UART_FOR_CONSOLE
	int
	default 2

config POST_DEVICE
	bool
	default n

config CONSOLE_POST
	bool
	default y

endif
```

## src/mainboard/clevo/n650du/Kconfig.name
```kconfig
# SPDX-License-Identifier: GPL-2.0-only

comment "Skylake / Kaby Lake"

config BOARD_CLEVO_N650DU
	bool "N650UD"
```
